## support/Config.in
```kconfig
config BR2_PACKAGE_RASPBERRYPI_FIRMWARE_RAUC_BOOTLOADER_BACKEND
	bool "raspberrypi-firmware-rauc-bootloader-backend"
	select BR2_PACKAGE_BASH # runtime
	select BR2_PACKAGE_BUSYBOX_SHOW_OTHERS # bash
	select BR2_USE_MMU # bash
	help
	  An implementation of a RAUC custom bootloader backend for the
	  Raspberry Pi firmware.

	  https://www.portay.io/raspberrypi-firmware-rauc-bootloader-backend/
```
